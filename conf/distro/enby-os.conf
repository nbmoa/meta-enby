## conf/distro/enby-os.conf
```bitbake
require conf/distro/poky.conf

DISTRO = "enby-os"
DISTRO_NAME = "enby OS"
DISTRO_VERSION = "0.1.0"
HOSTOS_VERSION = "${DISTRO_VERSION}"

# Systemd please
DISTRO_FEATURES_append = " systemd virtualization"
VIRTUAL-RUNTIME_init_manager = "systemd"

# Comment this out to enable sysvinit in minimal image
DISTRO_FEATURES_BACKFILL_CONSIDERED = "sysvinit"


##################################################<3
# meta-mender/meta-mender-raspberrypi - Begin
##################################################<3
# TBD Needs to be platform specific
# TBD Move into include file
RPI_USE_U_BOOT = "1"
MENDER_PARTITION_ALIGNMENT_KB = "4096"
MENDER_BOOT_PART_SIZE_MB = "40"

IMAGE_INSTALL_append = " kernel-image kernel-devicetree"

# Mender will build an image called `sdimg` which shall be used instead
# of the `rpi-sdimg`.
IMAGE_FSTYPES_remove += " rpi-sdimg"

# Use the same type here as specified in IMAGE_FSTYPES to avoid
# building an unneeded image file.
SDIMG_ROOTFS_TYPE = "ext4"

##################################################<3
# meta-mender/meta-mender-raspberrypi - End
##################################################<3

# Strip down unneeded features
POKY_DEFAULT_DISTRO_FEATURES_remove = "ptest"
POKY_DEFAULT_DISTRO_FEATURES_remove = "wayland"
DISTRO_FEATURES_DEFAULT_remove = "x11"
```

## conf/layer.conf
```bitbake
# We have a conf and classes directory, add to BBPATH
BBPATH .= ":${LAYERDIR}"

# We have recipes-* directories, add to BBFILES
BBFILES += "${LAYERDIR}/recipes-*/*/*.bb \
	${LAYERDIR}/recipes-*/*/*.bbappend"

BBFILE_COLLECTIONS += "enby"
BBFILE_PATTERN_enby = "^${LAYERDIR}/"
BBFILE_PRIORITY_enby = "6"
LAYERSERIES_COMPAT_enby = "sumo"
```
